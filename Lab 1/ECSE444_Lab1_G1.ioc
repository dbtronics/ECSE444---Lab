# file: ECSE444_Lab1_G1.ioc
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Mcu.Family=STM32L4
RCC.MSI_VALUE=4000000
RCC.CortexFreq_Value=120000000
RCC.SYSCLKSource=RCC_SYSCLKSOURCE_PLLCLK
ProjectManager.StackSize=0x400
PB3\ (JTDO/TRACESWO).Signal=SYS_JTDO-SWO
ProjectManager.TargetToolchain=STM32CubeIDE
RCC.HCLKFreq_Value=120000000
RCC.APB2TimFreq_Value=120000000
RCC.LSE_VALUE=32768
RCC.AHBFreq_Value=120000000
RCC.HSE_VALUE=8000000
board=custom
RCC.VCOOutputFreq_Value=240000000
RCC.APB2Freq_Value=120000000
VP_TIM2_VS_ClockSourceINT.Mode=Internal
NVIC.TIM2_IRQn=true\:0\:0\:false\:false\:true\:true\:true
TIM2.Period=3000
Mcu.Name=STM32L4S5VITx
RCC.SYSCLKFreq_VALUE=120000000
Mcu.Package=LQFP100
TIM2.Prescaler=40000
ProjectManager.HeapSize=0x200
RCC.HSI_VALUE=16000000
NVIC.PriorityGroup=NVIC_PRIORITYGROUP_4
RCC.PLLN=60
RCC.APB1TimFreq_Value=120000000
RCC.APB1Freq_Value=120000000
RCC.HSI48_VALUE=48000000
PA13\ (JTMS/SWDIO).Signal=SYS_JTMS-SWDIO

// file: Core/Src/main.c
/* USER CODE BEGIN Header */
/**
  ******************************************************************************
  * @file           : main.c
  * @brief          : Main program body
  ******************************************************************************
  * @attention
  *
  * <h2><center>&copy; Copyright (c) 2021 STMicroelectronics.
  * All rights reserved.</center></h2>
  *
  * This software component is licensed by ST under BSD 3-Clause license,
  * the "License"; You may not use this file except in compliance with the
  * License. You may obtain a copy of the License at:
  *                        opensource.org/licenses/BSD-3-Clause
  *
  ******************************************************************************
  */
/* USER CODE END Header */
#include "main.h" //allows us to specify data types such as uint32
#include "arm_math.h"
#include "math.h"
#include "utility.h"

/* USER CODE BEGIN Includes */
#include "kalmanfilter_asm.h"
#include "stdio.h"
/* USER CODE END Includes */

/* USER CODE BEGIN PD */
#define ITM_Port32(n) (*((volatile unsigned long *)(0xE0000000+4*n)))
/* USER CODE END PD */

TIM_HandleTypeDef htim2;

/* USER CODE BEGIN PV */
float TEST_ARRAY[] = {10.4915760032, 10.1349974709, 9.53992591829, 9.60311878706,
					10.4858891793, 10.1104642352, 9.51066931906, 9.75755656493,
					9.82154078273, 10.2906541933, 10.4861328671, 9.57321181356,
					9.70882714139, 10.4359069357, 9.70644021369, 10.2709894039,
					10.0823149505, 10.2954563443, 9.57130449017, 9.66832136479,
					10.4521677502, 10.4287240667, 10.1833650752, 10.0066049721,
					10.3279461634, 10.4767210803, 10.3790964606, 10.1937408814,
					10.0318963522, 10.4939180917, 10.2381858895, 9.59703103024,
					9.62757986516, 10.1816981174, 9.65703773168, 10.3905666599,
					10.0941977598, 9.93515274393, 9.71017053437, 10.0303874259,
					10.0173504397, 9.69022731474, 9.73902896102, 9.52524419732,
					10.3270730526, 9.54695650657, 10.3573960542, 9.88773266876,
					10.1685038683, 10.1683694089, 9.88406620159, 10.3290065898,
					10.2547227265, 10.4733422906, 10.0133952458, 10.4205693583,
					9.71335255372, 9.89061396699, 10.1652744131, 10.2580948608,
					10.3465431058, 9.98446410493, 9.79376005657, 10.202518901,
					9.83867150985, 9.89532986869, 10.2885062658, 9.97748768804,
					10.0403923759, 10.1538911808, 9.78303667556, 9.72420149909,
					9.59117495073, 10.1716116012, 10.2015818969, 9.90650056596,
					10.3251329834, 10.4550120431, 10.4925749165, 10.1548177178,
					9.60547133785, 10.4644672766, 10.2326496615, 10.2279703226,
					10.3535284606, 10.2437410625, 10.3851531317, 9.90784804928,
					9.98208344925, 9.52778805729, 9.69323876912, 9.92987312087,
					9.73938925207, 9.60543743477, 9.79600805462, 10.4950988486,
					10.2814361401, 9.7985283333, 9.6287888922, 10.4491538991,
					9.5799256668};

//float TEST_ARRAY[] = {0,1,2,3,4};
/* USER CODE END PV */

void SystemClock_Config(void);
static void MX_GPIO_Init(void);
static void MX_TIM2_Init(void);

int main(void)
{
  /* USER CODE BEGIN 1 */
	HAL_Init();

	uint32_t size = sizeof(TEST_ARRAY)/sizeof(float);
	uint32_t isValid = 0;
	float asm_result = 0;

	struct self asm_kalman_state = {
				0.1, //q
				0.1, //r
				5, //x
				0.1,//p
				0 //k
	};
	struct self c_kalman_state = {
				0.1, //q
				0.1, //r
				5, //x
				0.1,//p
				0 //k
	};
	struct self cmsis_kalman_state = {
				0.1, //q
				0.1, //r
				5.0, //x
				0.1,//p
				0 //k
	};
	struct statistics c_stats = {0.0, 0.0, 0.0}; //init with array elements set empty
	struct statistics cmsis_stats = {0.0, 0.0, 0.0};
  /* USER CODE END 1 */

  /* MCU Configuration--------------------------------------------------------*/

  /* Reset of all peripherals, Initializes the Flash interface and the Systick. */
  HAL_Init();

  /* Configure the system clock */
  SystemClock_Config();

  /* Initialize all configured peripherals */
  MX_GPIO_Init();
  MX_TIM2_Init();

  /* Infinite loop */
  while (1)
  {

    /* USER CODE BEGIN 3 */
		ITM_Port32(31) = 1; //timing analysis port
	    //ASM Implementation
		for(uint32_t i=0; i<size; i++){
			  kalmanfilter(&asm_kalman_state, &TEST_ARRAY[i], &isValid);
			  if(isValid){
				  asm_result = asm_kalman_state.x;
				  printf("Result (self.x) = %f\n",asm_result);
			  }else{
				  printf("Invalid = %ld\n",isValid);
			  }
		}
		ITM_Port32(31) = 2;
		//C implementation
		for(uint32_t i=0; i<size; i++){
			c_kalmanfilter(&c_kalman_state, &TEST_ARRAY[i]);
			c_stats.outputArray[i] = c_kalman_state.x;
			c_stats.inputArray[i] = TEST_ARRAY[i];
		}
		//CMSIS-DSP
		ITM_Port32(31) = 3;

		for(uint32_t i=0; i<size; i++){
			cmsis_stats.inputArray[i] = TEST_ARRAY[i];
			cmsis_kalmanfilter(&cmsis_kalman_state, &cmsis_stats, i);
			cmsis_stats.outputArray[i] = cmsis_kalman_state.x;
		}
		ITM_Port32(31) = 4;

		//C Ananlysis
		c_analysis(&c_stats,&TEST_ARRAY,&c_stats.outputArray);
		ITM_Port32(31) = 5;
		//CMSIS Analysis
		cmsis_analysis(&cmsis_stats, size);
		ITM_Port32(31) = 6;
  }
  /* USER CODE END 3 */
}

void SystemClock_Config(void)
{
  RCC_OscInitTypeDef RCC_OscInitStruct = {0};
  RCC_ClkInitTypeDef RCC_ClkInitStruct = {0};

  /** Configure the main internal regulator output voltage
  */
  if (HAL_PWREx_ControlVoltageScaling(PWR_REGULATOR_VOLTAGE_SCALE1_BOOST) != HAL_OK)
  {
    Error_Handler();
  }
  /** Initializes the RCC Oscillators according to the specified parameters
  * in the RCC_OscInitTypeDef structure.
  */
  RCC_OscInitStruct.OscillatorType = RCC_OSCILLATORTYPE_MSI;
  RCC_OscInitStruct.MSIState = RCC_MSI_ON;
  RCC_OscInitStruct.MSICalibrationValue = 0;
  RCC_OscInitStruct.MSIClockRange = RCC_MSIRANGE_6;
  RCC_OscInitStruct.PLL.PLLState = RCC_PLL_ON;
  RCC_OscInitStruct.PLL.PLLSource = RCC_PLLSOURCE_MSI;
  RCC_OscInitStruct.PLL.PLLM = 1;
  RCC_OscInitStruct.PLL.PLLN = 60;
  RCC_OscInitStruct.PLL.PLLP = RCC_PLLP_DIV2;
  RCC_OscInitStruct.PLL.PLLQ = RCC_PLLQ_DIV2;
  RCC_OscInitStruct.PLL.PLLR = RCC_PLLR_DIV2;
  if (HAL_RCC_OscConfig(&RCC_OscInitStruct) != HAL_OK)
  {
    Error_Handler();
  }
  /** Initializes the CPU, AHB and APB buses clocks
  */
  RCC_ClkInitStruct.ClockType = RCC_CLOCKTYPE_HCLK|RCC_CLOCKTYPE_SYSCLK
                              |RCC_CLOCKTYPE_PCLK1|RCC_CLOCKTYPE_PCLK2;
  RCC_ClkInitStruct.SYSCLKSource = RCC_SYSCLKSOURCE_PLLCLK;
  RCC_ClkInitStruct.AHBCLKDivider = RCC_SYSCLK_DIV1;
  RCC_ClkInitStruct.APB1CLKDivider = RCC_HCLK_DIV1;
  RCC_ClkInitStruct.APB2CLKDivider = RCC_HCLK_DIV1;

  if (HAL_RCC_ClockConfig(&RCC_ClkInitStruct, FLASH_LATENCY_5) != HAL_OK)
  {
    Error_Handler();
  }
}

static void MX_TIM2_Init(void)
{

  TIM_ClockConfigTypeDef sClockSourceConfig = {0};
  TIM_MasterConfigTypeDef sMasterConfig = {0};

  htim2.Instance = TIM2;
  htim2.Init.Prescaler = 40000;
  htim2.Init.CounterMode = TIM_COUNTERMODE_UP;
  htim2.Init.Period = 3000;
  htim2.Init.ClockDivision = TIM_CLOCKDIVISION_DIV1;
  htim2.Init.AutoReloadPreload = TIM_AUTORELOAD_PRELOAD_DISABLE;
  if (HAL_TIM_Base_Init(&htim2) != HAL_OK)
  {
    Error_Handler();
  }
  sClockSourceConfig.ClockSource = TIM_CLOCKSOURCE_INTERNAL;
  if (HAL_TIM_ConfigClockSource(&htim2, &sClockSourceConfig) != HAL_OK)
  {
    Error_Handler();
  }
  sMasterConfig.MasterOutputTrigger = TIM_TRGO_RESET;
  sMasterConfig.MasterSlaveMode = TIM_MASTERSLAVEMODE_DISABLE;
  if (HAL_TIMEx_MasterConfigSynchronization(&htim2, &sMasterConfig) != HAL_OK)
  {
    Error_Handler();
  }

}

static void MX_GPIO_Init(void)
{

  /* GPIO Ports Clock Enable */
  __HAL_RCC_GPIOA_CLK_ENABLE();
  __HAL_RCC_GPIOB_CLK_ENABLE();

}

void Error_Handler(void)
{
  __disable_irq();
  while (1)
  {
  }
}

/************************ (C) COPYRIGHT STMicroelectronics *****END OF FILE****/
